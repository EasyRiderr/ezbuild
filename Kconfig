## Kconfig
```kconfig
mainmenu "EZbuild"

# Include subdirectories Kconfig
source maths_func/Kconfig
source other_func/Kconfig
```

## maths_func/Kconfig
```kconfig
menu "Maths functions"

	config MUL
		bool "Enable multiplications"
		default y

	# Include subdirectories Kconfig
	source maths_func/add/Kconfig

endmenu
```

## maths_func/add/Kconfig
```kconfig
menu "Maths functions - addition options"

	config ADD
		bool "Add function that will sum given parameters"
		default y

	config ADD_2
		bool "Add function that will add 2 to the given parameters"
		default n

endmenu
```

## other_func/Kconfig
```kconfig
# Nothing special to do in this directory yet, include subdirectory Kconfig
source say_hi/Kconfig
```

## other_func/say_hi/Kconfig
```kconfig
menu "Other functions"

	config SAY_HI
		bool "Enable the \"Say hi\" function"
		default y

	config SAY_HI_TO
		string "Say hello to whom ?"
		default "World"
		depends on SAY_HI

endmenu
```
